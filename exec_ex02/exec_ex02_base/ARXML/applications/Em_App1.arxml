AUTOSAR XML (schema 00048)
package /mga/autoever/sample/em_app1
  process App1: design=App1Design, executable=Executable_App1, log-trace-default-log-level=INFO, log-trace-log-modes=CONSOLE, log-trace-process-desc=APP1 DLT, log-trace-process-id=APP1, state-dependent-startup-config{function-group-state=[MachineState.Parking, MachineState.Startup], resource-group=ResourceGroup_1, startup-config=StartupConfig_1}
    process state machine ProcessStateMachine: type=App1_ProcessStateMachine_ModeDeclarationGroup
  process design App1Design: executable=Executable_App1
  mode declaration group App1_ProcessStateMachine_ModeDeclarationGroup
    mode Running
    mode Terminated
  executable Executable_App1: category=APPLICATION_LEVEL, build-type=BUILD-TYPE-DEBUG, logging-behavior=USES-LOGGING, reporting-behavior=REPORTS-EXECUTION-STATE
    root sw component prototype RootSwComponent: application-type=SWC_App1
  process to machine mapping set ProcessToMachineMappingSet_1
    process to machine mapping ProcessToMachineMap_1: machine=Machine_ECU, process=App1, shall-run-on=MachineProcessor_Core_0
  adaptive application sw component type SWC_App1
  startup config set StartupConfigSet_App1
    startup config StartupConfig_1: scheduling-policy=SCHEDULING-POLICY-ROUND-ROBIN, scheduling-priority=20, timeout={enter-timeout-value=2.0, exit-timeout-value=2.0}
