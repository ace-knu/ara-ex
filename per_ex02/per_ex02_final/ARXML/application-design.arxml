AUTOSAR XML (schema 00048)
package /mobilgene/perdemo
  persistency key value database KeyValueDeployment_1: maximum-allowed-size=12000, minimum-sustained-size=800, redundancy-handlings=persistency-redundancy-m-out-of-n={scope=PERSISTENCY-REDUNDANCY-HANDLING-SCOPE-DATABASE, m=3, n=5}, update-strategy=DELETE, uri=var/MobilgeneMofNKVS.json
    9 x persistency key value pair, all with update-strategy=DELETE:
      KeyOfBool: init-value=true, value-data-type=bool
      KeyOfDouble: init-value=1.234567, value-data-type=double
      KeyOfDoubleVector: init-value=[0.1234, 1234.56789, 0.1], value-data-type=DoubleVector
      KeyOfFloat: init-value=1.234567, value-data-type=float
      KeyOfInt64: init-value=-240000000000, value-data-type=int64_t
      KeyOfStringElement1: init-value=[H, e, l, l, o, , W, o, r, l, d, !, !], value-data-type=String
      KeyOfStringElement2: init-value=[H, e, l, l, o, , A, u, t, r, o, n, !, !], value-data-type=String
      KeyOfStringElement3: init-value=[H, e, l, l, o, , S, W, P, !, !], value-data-type=String
      KeyOfUint64: init-value=240000000000, value-data-type=uint64_t
  persistency key value database interface KeyValueInterface_1: minimum-sustained-size=800, redundancy=REDUNDANT, update-strategy=DELETE, data-type-for-serialization=[DoubleVector, String, bool, double, float, int64_t, uint64_t]
    9 x persistency data element, all with update-strategy=DELETE:
      KeyOfBool: type=bool
      KeyOfDouble: type=double
      KeyOfDoubleVector: type=DoubleVector
      KeyOfFloat: type=float
      KeyOfInt64: type=int64_t
      KeyOfStringElement{1..3}: type=String
      KeyOfUint64: type=uint64_t
  process PerExampleKvs: design=PerExampleKvsDesign, executable=PerExampleKvsEx, log-trace-default-log-level=INFO, log-trace-log-modes=CONSOLE, log-trace-process-desc=Internal persistency debug context, log-trace-process-id=APEK, state-dependent-startup-config{function-group-state=[MachineState.Driving, MachineState.Parking, MachineState.Startup], startup-config=StartupConfig_1}
    process state machine ProcessStateMachine: type=PerExampleKvs_ProcessStateMachine_ModeDeclarationGroup
  process design PerExampleKvsDesign: executable=PerExampleKvsEx
  executable PerExampleKvsEx: category=APPLICATION_LEVEL, build-type=BUILD-TYPE-DEBUG, logging-behavior=USES-LOGGING, reporting-behavior=REPORTS-EXECUTION-STATE
    root sw component prototype RootSwComponent: application-type=SwComponent_PerExampleKvs
  mode declaration group PerExampleKvs_ProcessStateMachine_ModeDeclarationGroup
    mode Running
    mode Terminated
  persistency port prototype to key value database mapping PortToKeyValueMap_1: key-value-storage=KeyValueDeployment_1, port-prototype=MobilgeneMofNKVS, process=PerExampleKvs
  process to machine mapping set ProcessToMachineMapppingSet_1
    process to machine mapping ProcessToMachineMap_1: machine=Machine_ECU, process=PerExampleKvs
  startup config set StartupConfigSet1
    startup config StartupConfig_1: scheduling-policy=SCHEDULING-POLICY-FIFO, scheduling-priority=15
  adaptive application sw component type SwComponent_PerExampleKvs
    provide/require port MobilgeneMofNKVS: provided-required-interface=KeyValueInterface_1
