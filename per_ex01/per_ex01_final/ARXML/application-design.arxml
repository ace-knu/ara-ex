AUTOSAR XML (schema 00048)
package /mobilgene/perdemo
  persistency file array FileArray_1: maximum-allowed-size=12000, minimum-sustained-size=400, redundancy-handlings=persistency-redundancy-m-out-of-n={scope=PERSISTENCY-REDUNDANCY-HANDLING-SCOPE-FILE, m=3, n=5}, update-strategy=DELETE, uri=var/MobilgeneMofNFP
    persistency file FileProxy_1: content-uri=files/MobilgeneMofNFP/ReadOnlyFile1.txt, file-name=ReadOnlyFile1.txt, update-strategy=DELETE
    persistency file FileProxy_2: content-uri=files/MobilgeneMofNFP/WriteOnlyFile1.txt, file-name=WriteOnlyFile1.txt, update-strategy=DELETE
    persistency file FileProxy_3: content-uri=files/MobilgeneMofNFP/ReadWriteFile1.txt, file-name=ReadWriteFile1.txt, update-strategy=DELETE
  persistency file proxy interface FileProxyInterface_1: category=TEXT_FILE, minimum-sustained-size=400, redundancy=REDUNDANT, update-strategy=DELETE, encoding=UTF-8, max-number-of-files=3
    persistency file proxy FileProxy_1: content-uri=files/MobilgeneMofNFP/ReadOnlyFile1.txt, file-name=ReadOnlyFile1.txt, update-strategy=DELETE
    persistency file proxy FileProxy_2: content-uri=files/MobilgeneMofNFP/WriteOnlyFile1.txt, file-name=WriteOnlyFile1.txt, update-strategy=DELETE
    persistency file proxy FileProxy_3: content-uri=files/MobilgeneMofNFP/ReadWriteFile1.txt, file-name=ReadWriteFile1.txt, update-strategy=DELETE
  process PerExampleFs: design=PerExampleFsDesign, executable=PerExampleFsEx, log-trace-default-log-level=INFO, log-trace-log-modes=CONSOLE, log-trace-process-desc=Internal persistency debug context, log-trace-process-id=APEF, state-dependent-startup-config{function-group-state=[MachineState.Driving, MachineState.Parking, MachineState.Startup], startup-config=StartupConfig_1}
    process state machine ProcessStateMachine: type=PerExampleFs_ProcessStateMachine_ModeDeclarationGroup
  process design PerExampleFsDesign: executable=PerExampleFsEx
  executable PerExampleFsEx: category=APPLICATION_LEVEL, build-type=BUILD-TYPE-DEBUG, logging-behavior=USES-LOGGING, reporting-behavior=REPORTS-EXECUTION-STATE
    root sw component prototype RootSwComponent: application-type=SwComponent_PerExampleFs
  mode declaration group PerExampleFs_ProcessStateMachine_ModeDeclarationGroup
    mode Running
    mode Terminated
  persistency port prototype to file array mapping PortToFileMap_1: persistency-file-array=FileArray_1, port-prototype=MobilgeneMofNFP, process=PerExampleFs
  process to machine mapping set ProcessToMachineMapppingSet_1
    process to machine mapping ProcessToMachineMap_1: machine=Machine_ECU, process=PerExampleFs
  startup config set StartupConfigSet1
    startup config StartupConfig_1: scheduling-policy=SCHEDULING-POLICY-FIFO, scheduling-priority=15
  adaptive application sw component type SwComponent_PerExampleFs
    provide/require port MobilgeneMofNFP: provided-required-interface=FileProxyInterface_1
