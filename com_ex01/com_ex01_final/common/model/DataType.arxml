AUTOSAR XML (schema 00048)
package /DataTypes/ApAppError
  ap application error GenericFailure: error-code=12, error-domain=GenericErrors  # Generic failure
  ap application error InvalidConfigString: error-code=5, error-domain=SpecificErrors  # Configuration string is invalid
  ap application error InvalidParameter: error-code=6, error-domain=SpecificErrors  # Parameter is invalid
package /DataTypes/ApAppErrorDomain
  ap application error domain GenericErrors: value=45
    namespaces:
      symbol props ara
      symbol props com
      symbol props sample
  ap application error domain SpecificErrors: value=44
    namespaces:
      symbol props ara
      symbol props com
      symbol props sample
package /DataTypes/DataType/IDT
  5 x std cpp implementation data type, all with type-emitter=TYPE_EMITTER_ARA:
    ByteArray: category=VECTOR, cpp-template-argument=uint8_t
    FusionVariant: compu {0x01=FV_CHINA, 0x05=FV_USA, 0x06=FV_EUROPE, 0x04=FV_RUSSIA}, type-reference=UnsignedInt
      namespaces:
        symbol props ara
        symbol props com
        symbol props sample
    Position: category=STRUCTURE
      namespaces:
        symbol props ara
        symbol props com
        symbol props sample
      cpp implementation data type element x: type-reference=int32_t
      cpp implementation data type element y: type-reference=int32_t
      cpp implementation data type element z: type-reference=int32_t
    RadarObjects: category=STRUCTURE
      namespaces:
        symbol props ara
        symbol props com
        symbol props sample
      cpp implementation data type element active: type-reference=bool
      cpp implementation data type element objectVector: type-reference=ByteArray
    UnsignedInt: type-reference=uint16_t
      namespaces:
        symbol props ara
        symbol props com
        symbol props sample
