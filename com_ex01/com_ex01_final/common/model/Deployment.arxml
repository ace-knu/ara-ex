AUTOSAR XML (schema 00048)
package /Deployment/Someip
  someip service interface deployment Someip_radarDep_1: service-interface=radar, service-interface-id=99, service-interface-version={major-version=1, minor-version=0}
    someip event deployment Someip_brakeEventDep: event=brakeEvent, event-id=1, maximum-segment-length=0, separation-time=0.0, serializer=SOMEIP, transport-protocol=UDP
    someip event deployment Someip_parkingBrakeEventDep: event=parkingBrakeEvent, event-id=2, maximum-segment-length=0, separation-time=0.0, serializer=SOMEIP, transport-protocol=UDP
    4 x someip field deployment:
      Someip_FrontObjectDistanceDep_1: field=FrontObjectDistance
        notifier Someip_FrontObjectDistanceDep_Notifier: event-id=3004, maximum-segment-length=0, separation-time=0.0, serializer=SOMEIP, transport-protocol=UDP
      Someip_ObjectDetectionLimitDep_1: field=ObjectDetectionLimit
        set Someip_ObjectDetectionLimitDep_Setter: method-id=3011, transport-protocol=TCP
      Someip_RearObjectDistanceDep_1: field=RearObjectDistance
        get Someip_RearObjectDistanceDep_Getter: method-id=3006, transport-protocol=TCP
      Someip_UpdateRateDep_1: field=UpdateRate
        get Someip_UpdateRateDep_Getter: method-id=3001, transport-protocol=TCP
        notifier Someip_UpdateRateDep_Notifier: event-id=3000, maximum-segment-length=0, separation-time=0.0, serializer=SOMEIP, transport-protocol=UDP
        set Someip_UpdateRateDep_Setter: method-id=3002, transport-protocol=TCP
    5 x someip method deployment, all with maximum-segment-length-request=0, maximum-segment-length-response=0, separation-time-request=0.0, separation-time-response=0.0, transport-protocol=UDP:
      Someip_AdjustDep: method=Adjust, method-id=32000
      Someip_CalibrateDep: method=Calibrate, method-id=32010
      Someip_EchoDep: method=Echo, method-id=32020
      Someip_testDoubleDep: method=testDouble, method-id=32022
      Someip_testFloatDep: method=testFloat, method-id=32021
    4 x someip event group:
      EventGroup_1: event-group-id=1, event=Someip_brakeEventDep
      EventGroup_2: event-group-id=2, event=Someip_parkingBrakeEventDep
      EventGroup_3: event-group-id=3, event=Someip_FrontObjectDistanceDep_Notifier
      EventGroup_4: event-group-id=4, event=Someip_UpdateRateDep_Notifier
