AUTOSAR XML (schema 00048)
package /fusion/Application/Executable
  executable fusionExe: category=APPLICATION_LEVEL, build-type=BUILD-TYPE-DEBUG, logging-behavior=USES-LOGGING, reporting-behavior=REPORTS-EXECUTION-STATE
    root sw component prototype RootSwComponent: application-type=fusion
package /fusion/Application/Process
  process fusion_Process:
    design=fusion_ProcessDesign
    executable=fusionExe
    log-trace-default-log-level=INFO
    log-trace-file-path=/adar/install/var
    log-trace-log-modes=[CONSOLE, FILE]
    log-trace-process-desc=Com Sample Consumer App IPC
    log-trace-process-id=ACFA
    state-dependent-startup-config{execution-dependency=ProcessStateMachine.Running, function-group-state=[MachineState.Restart, MachineState.Shutdown, MachineState.Startup], resource-group=ResourceGroup_1, startup-config=StartupConfig_1}
    process state machine ProcessStateMachine: type=fusion_Process_ProcessStateMachine_ModeDeclarationGroup
  mode declaration group fusion_Process_ProcessStateMachine_ModeDeclarationGroup
    mode Running
    mode Terminated
  startup config set fusionconfig
    startup config StartupConfig_1: scheduling-policy=SCHEDULING-POLICY-FIFO, scheduling-priority=15
package /fusion/Application/ProcessDesign
  process design fusion_ProcessDesign: executable=fusionExe
package /fusion/Application/SwComponent
  adaptive application sw component type fusion
    require port radar_RPort: required-interface=radar
package /fusion/Service/Instance
  someip sd client event group timing config client_timingConf_1: request-response-delay={max-value=10.0, min-value=10.0}, subscribe-eventgroup-retry-delay=10.0, subscribe-eventgroup-retry-max=10, time-to-live=0
  someip sd client event group timing config client_timingConf_2: request-response-delay={max-value=10.0, min-value=10.0}, subscribe-eventgroup-retry-delay=10.0, subscribe-eventgroup-retry-max=10, time-to-live=0
  required someip service instance radar_RequiredSomeipServiceInstance: service-interface-deployment=Someip_radarDep_1, required-minor-version=0, required-service-instance-id=ANY, sd-client-config=radar_SomeipClientServiceInstanceConfig, version-driven-find-behavior=MINIMUM-MINOR-VERSION
    method-request-propss:
      Someip_ObjectDetectionLimitDep_Setter
      Someip_RearObjectDistanceDep_Getter
      Someip_UpdateRateDep_Setter
      Someip_UpdateRateDep_Getter
    someip required event group SomeipREventGroup_1: event-group=EventGroup_1, sd-client-event-group-timing-config=client_timingConf_1
    someip required event group SomeipREventGroup_2: event-group=EventGroup_2, sd-client-event-group-timing-config=client_timingConf_2
  someip sd client service instance config radar_SomeipClientServiceInstanceConfig: initial-find-behavior={initial-delay-max-value=0.1, initial-delay-min-value=0.01, initial-repetitions-base-delay=0.2, initial-repetitions-max=3}, service-find-time-to-live=10
package /fusion/Service/InstancePortMap
  service instance to port prototype mapping radar_RequiredServiceInstance_toPort: port-prototype=radar_RPort, process=fusion_ProcessDesign, service-instance=radar_RequiredSomeipServiceInstance
