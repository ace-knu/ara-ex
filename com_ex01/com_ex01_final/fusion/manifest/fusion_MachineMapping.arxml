AUTOSAR XML (schema 00048)
package /fusion/InstanceToMachineMapping
  someip service instance to machine mapping radar_RequiredServiceInstance_toMachine: communication-connector=Connector_ECU, service-instance=radar_RequiredSomeipServiceInstance, udp-port=5001
package /fusion/ProcessToMachineMappingSet
  process to machine mapping set Machine_ECUMapping
    process to machine mapping fusionMapping: machine=Machine_ECU, process=fusion_Process
